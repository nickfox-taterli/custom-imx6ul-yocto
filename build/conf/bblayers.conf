## build/conf/bblayers.conf
```bitbake
POKY_BBLAYERS_CONF_VERSION = "2"

BBPATH = "${TOPDIR}"
BSPDIR := "${@os.path.abspath(os.path.dirname(d.getVar('FILE', True)) + '/../..')}"

BBFILES ?= ""
BBLAYERS = " \
  ${BSPDIR}/sources/poky/meta \
  ${BSPDIR}/sources/poky/meta-poky \
  \
  ${BSPDIR}/sources/meta-openembedded/meta-oe \
  ${BSPDIR}/sources/meta-openembedded/meta-multimedia \
  \
  ${BSPDIR}/sources/meta-fsl-arm \
  ${BSPDIR}/sources/meta-fsl-arm-extra \
  ${BSPDIR}/sources/meta-fsl-demos \
"
##Freescale Yocto Project Release layer
BBLAYERS += " ${BSPDIR}/sources/meta-fsl-bsp-release/imx/meta-bsp "
BBLAYERS += " ${BSPDIR}/sources/meta-fsl-bsp-release/imx/meta-sdk "
BBLAYERS += " ${BSPDIR}/sources/meta-browser "
BBLAYERS += " ${BSPDIR}/sources/meta-openembedded/meta-gnome "
BBLAYERS += " ${BSPDIR}/sources/meta-openembedded/meta-networking "
BBLAYERS += " ${BSPDIR}/sources/meta-openembedded/meta-python "
BBLAYERS += " ${BSPDIR}/sources/meta-openembedded/meta-filesystems "
BBLAYERS += " ${BSPDIR}/sources/meta-qt5 "
BBLAYERS += " ${BSPDIR}/sources/meta-custom-imx6ul "
BBLAYERS += " ${BSPDIR}/sources/meta-swupdate "
```

## sources/meta-custom-imx6ul/conf/layer.conf
```bitbake
# We have a conf and classes directory, add to BBPATH
BBPATH .= ":${LAYERDIR}"

# We have recipes-* directories, add to BBFILES
BBFILES += "${LAYERDIR}/recipes-*/*/*.bb \
	${LAYERDIR}/recipes-*/*/*.bbappend"

BBFILE_COLLECTIONS += "custom-imx6ul"
BBFILE_PATTERN_custom-imx6ul = "^${LAYERDIR}/"
BBFILE_PRIORITY_custom-imx6ul = "8"

LAYERDEPENDS_custom-imx6ul-yocto += "swupdate"
```

## sources/meta-custom-imx6ul/conf/machine/custom.conf
```bitbake
#@TYPE: Machine
#@SOC: i.MX6UL
#@DESCRIPTION: Machine configuration
#@MAINTAINER: TaterLi <admin@taterli.com>

include conf/machine/include/custom-base.inc
include conf/machine/include/tune-cortexa7.inc
include conf/machine/include/custom-common.inc

SOC_FAMILY = "mx6ul"

KERNEL_DEVICETREE = "custom-imx6ul-ext.dtb"

UBOOT_CONFIG ??= "nand"
UBOOT_CONFIG[nand] = "custom_imx6ul_nand_config,nand"

# Install brcm firmware
MACHINE_FIRMWARE_append = " firmware-imx-brcm"
```
